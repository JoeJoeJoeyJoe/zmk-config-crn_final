## boards/shields/crn/Kconfig.defconfig
```kconfig
if SHIELD_CRN_LEFT

config ZMK_KEYBOARD_NAME
    default "Corne CRN"

# The left side is the central/master side
config ZMK_SPLIT_ROLE_CENTRAL
    default y

endif

if SHIELD_CRN_LEFT || SHIELD_CRN_RIGHT

config ZMK_SPLIT
    default y

# Studio ist DEAKTIVIERT für einfachen Build
# Später kannst du es aktivieren wenn du willst

endif
```

## boards/shields/crn/Kconfig.shield
```kconfig
config SHIELD_CRN_LEFT
    def_bool $(shields_list_contains,crn_left)

config SHIELD_CRN_RIGHT
    def_bool $(shields_list_contains,crn_right)
```

## config/west.yml
```yaml
manifest:
  defaults:
    # Stable version - bewährt und funktioniert!
    revision: v0.3
  remotes:
    - name: zmkfirmware
      url-base: https://github.com/zmkfirmware
  projects:
    - name: zmk
      remote: zmkfirmware
      import: app/west.yml
  self:
    path: config
```
